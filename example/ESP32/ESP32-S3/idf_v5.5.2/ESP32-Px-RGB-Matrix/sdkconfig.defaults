## example/ESP32/ESP32-S3/idf_v5.5.2/ESP32-Px-RGB-Matrix/sdkconfig.defaults
```kconfig
CONFIG_HUB75_BOARD_CUSTOM=y
CONFIG_HUB75_PANEL_WIDTH=64
CONFIG_HUB75_PANEL_HEIGHT=32
CONFIG_HUB75_LAYOUT_ROWS=1
CONFIG_HUB75_LAYOUT_COLS=1
CONFIG_HUB75_WIRING_STANDARD=y
CONFIG_HUB75_PIN_R1=4
CONFIG_HUB75_PIN_G1=5
CONFIG_HUB75_PIN_B1=6
CONFIG_HUB75_PIN_R2=7
CONFIG_HUB75_PIN_G2=15
CONFIG_HUB75_PIN_B2=16
CONFIG_HUB75_PIN_A=18
CONFIG_HUB75_PIN_B=8
CONFIG_HUB75_PIN_C=3
CONFIG_HUB75_PIN_D=42
CONFIG_HUB75_PIN_E=9
CONFIG_HUB75_PIN_LAT=40
CONFIG_HUB75_PIN_OE=2
CONFIG_HUB75_PIN_CLK=41
CONFIG_LV_FONT_UNSCII_16=y
CONFIG_LV_FONT_UNSCII_8=y
```
